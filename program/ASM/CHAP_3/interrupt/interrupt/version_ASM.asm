.CSEG
.INCLUDE "M8DEF.INC"
.ORG 0x000
	RJMP BATDAU
.ORG 0X001;DINH VECTO NGAT NGOAI 0
	RJMP INT0_ISR;NHAY DEN INT0_ISR NEU CO NGAT NGOAI
.ORG 0x002
	RJMP INT1_ISR
.ORG
BAUDAU:
;KHOI TAO STACK
	LDI R16, HIGH(RAMEND)
	LDI R17, LOW(RAMEND)
	OUT SPH, R16
	OUT SPL, R17
	CLR R25; XOA R25, R25 LA THANH GHI DUNG CHUA SO DEM
	//CLR R20; R20 LA THANH GHI TAM CHUA GIA TRI TRUOC DO CUA PIN
;SET CHAN PD2, PD3 NHU CHAN INPUT
	LDI R16, 0B00000000
	OUT DDRD, R16
	LDI R16, OB11111111
	OUT PORTD, R16
;KHOI DONG NGAT
	LDI R16, $0B;0B00001011 INT1 NGAT XUONG, INT0 NGAT LEN
	OUT MCUCR, R16; XUAT GIA TRI DIEU KHIEN RA MCUCR
	LDI R16, $C0;0B11000000 ENABLE INT1 VA INT0
	OUT GICR, R16
	SEI
MAIN:
	RJMP MAIN:

;INTERRUPT SERVICE INT1
INT0_ISR:
	INC R25
	CPI R25, 10
	BREQ RESET0
	OUT PORTB, R25
	RET
	XUAT1:
		OUT PORTB, R25
		RET
INT1_ISR:
	DEC R25
	CPI R25, 255
	BREQ RESET9

/*SOSANH:
	CPI R20, 9
	BREQ RESET0
	CPI R20, 0
	BREQ RESET9
	RET*/
RESET0:
	LDI R25, $0
	RJMP VETANG
RESET9
	LDI R25, $9
	RJMP VEGIAM
	
	