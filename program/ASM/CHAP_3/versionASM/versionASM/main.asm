.CSEG
.INCLUDE "M8DEF.INC"
.ORG 0x000
	RJMP BATDAU
.ORG 0X001;DINH VECTO NGAT NGOAI 0
	RJMP INT0_ISR;NHAY DEN INT0_ISR NEU CO NGAT NGOAI
.ORG 0x002
	RJMP INT1_ISR
.ORG 0x020
BATDAU:
;KHOI TAO STACK
	LDI R16, HIGH(RAMEND)
	LDI R17, LOW(RAMEND)
	OUT SPH, R16
	OUT SPL, R17
	CLR R25; XOA R25, R25 LA THANH GHI DUNG CHUA SO DEM
	LDI R25, $7
	
;SET CHAN PD2, PD3 NHU CHAN INPUT
	LDI R16, 0B00000000
	OUT DDRD, R16
	LDI R16, 0B11111111
	OUT PORTD, R16
	OUT DDRB, R16
	OUT PORTB, R25
;KHOI DONG NGAT
	LDI R16, $0B;0B00001011 INT1 NGAT XUONG, INT0 NGAT LEN
	OUT MCUCR, R16; XUAT GIA TRI DIEU KHIEN RA MCUCR
	LDI R16, $C0;0B11000000 ENABLE INT1 VA INT0
	OUT GICR, R16
MAIN:
	SEI
	RJMP MAIN

;INTERRUPT SERVICE INT1
INT0_ISR:
	DEC R25
	CPI R25, 255
	BREQ RESET9
	RJMP XUAT
INT1_ISR:
	INC R25
	CPI R25, 10
	BREQ RESET0
	RJMP XUAT
RESET0:
	LDI R25, 0
	RJMP XUAT
RESET9:
	LDI R25, 9
	RJMP XUAT
XUAT:
	OUT PORTB, R25
	RET
