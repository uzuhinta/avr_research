;
; Chap_2.asm
;
; Created: 28-Sep-19 5:26:22 PM
; Author : quann
;

.INCLUDE "M8DEF.INC"
.CSEG
.ORG 0x0000
	RJMP BATDAU
.ORG 0x0020
BATDAU:
	;KHỞI ĐỘNG POINTER STACK
	LDI R17, HIGH(RAMEND)
	LDI R16, LOW(RAMEND)
	OUT SPL, R16
	OUT SPH, R17;
	;THIẾT LẬP CAC PORT
	CLR R16;XÓA R16, R16 = 0
	OUT DDRD, R16;DDRD=0, PORTB LÀ NGÕ  NHẬP
	LDI R16, 0xFF;SET ALL BIT R16 = 1
	OUT PORTD, R16;DDRD=0, PORTD=0xFF, ĐIỆN TRỞ KÉO LÊN - PULL UP RESISTOR
	OUT DDRB, R16;DDRD=OxFF, PORTD LÀ NGÕ XUẤT
	CLR R25; XÓA R25, R25 LÀ THANH GHI CHỨA SỐ ĐẾM
	CLR R20; R20 LÀ THANH GHI CHỨA GIÁ TRỊ TẠM THỜI TRƯỚC ĐÓ.
MAIN:
	IN R21, PINB;ĐỌC GIÁ TRỊ TỪ PINB, TỨC LÀ TỪ BUTTON
	RCALL SOSANH;GỌI CHƯƠNG TRÌNH CON SO SÁNH
	OUT PORTD, R25; XUẤT GIÁ TRỊ ĐẾM RA PORTC
	SBRS R21, 0 ; NẾU 0 R21(PB0=1) BỎ QUA DÒNG SAU
	RCALL TANG
	SBRS R21, 1;NẾU BIT R21 (PB1 = 1) THÌ BỎ QUA DÒNG SAU
	RCALL GIAM
	MOV R20, R21 ; LƯU LẠI TRẠNG THÁI PINB
	RJMP MAIN

;;CHƯƠNG TRÌNH CON KIỂM TRA SỐ TỪ 0 ĐẾN 9
SOSANH:
	CPI R25, 10
	BREQ RESET0;NẾU GIÁ TRỊ ĐẾM TẠM THỜI = 10 THÌ TRẢ VỀ 0
	CPI R25,255
	BREQ RESET9;NẾU GIÁ TRỊ ĐẾM TẠM THỜI = 255 THÌ TRẢ VỀ 9
	RJMP QUAYVE
RESET0:
	LDI R25,$0
	RJMP QUAYVE
RESET9:
	LDI R25,$9
QUAYVE:
	RET

;TĂNG SỐ ĐẾM LÊN 1 ĐƠN VỊ
TANG:
	SBRS R20,0
	RET
	INC R25
	RET

;GIẢM SỐ ĐẾM XUỐNG 1 ĐƠN VỊ.
GIAM:
	SBRS R20, 1
	RET
	DEC R25
	RET